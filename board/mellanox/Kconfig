## board/mellanox/mlnxast2500bmc/Kconfig
```kconfig
if TARGET_MELLANOX_AST2500BMC

config SYS_CPU
	default "arm1176"

config SYS_BOARD
	default "mlnxast2500bmc"

config SYS_VENDOR
	default "mellanox"

config SYS_SOC
	default "aspeed"

config SYS_CONFIG_NAME
	default "mlnxast2500bmc"

config FIRMWARE_2ND_BOOT
	bool "Firmware second boot WD2 enable."
endif
```

## configs/mlnxast2500bmc_defconfig
```kconfig
CONFIG_ARM=y
CONFIG_TARGET_MELLANOX_AST2500BMC=y
CONFIG_LOCALVERSION="Mellanox AST2500 BMC"
CONFIG_IDENT_STRING="Mellanox AST2500 BMC"
CONFIG_SYS_ARCH="arm"
CONFIG_SYS_CPU="arm1176"
CONFIG_SYS_SOC="aspeed"
CONFIG_SYS_VENDOR="mellanox"
CONFIG_SYS_BOARD="mlnxast2500bmc"
CONFIG_SYS_CONFIG_NAME="mlnxast2500bmc"
CONFIG_ASPEED_NET_NCSI=y
CONFIG_SPI_FLASH=y
CONFIG_SYS_NS16550=y
CONFIG_CMD_FPGA=y
CONFIG_CMD_SAVEENV=y
CONFIG_CMD_FLASH=y
CONFIG_CMD_PING=y
CONFIG_CMD_DHCP=y
CONFIG_CMDLINE=y
CONFIG_HUSH_PARSER=y
CONFIG_SYS_PROMPT="BMC:U-Boot=> "
CONFIG_FIT=y
CONFIG_FIT_VERBOSE=y
CONFIG_NETDEVICES=y
CONFIG_OF_LIBFDT=y
CONFIG_CMD_GREPENV=y
CONFIG_CMD_MEMINFO=y
CONFIG_CMD_MII=y
CONFIG_CMD_EXT2=y
CONFIG_CMD_FAT=y
CONFIG_EXPERT=y
CONFIG_REGEX=y
CONFIG_CMD_IMI=y
CONFIG_CMD_IMLS=y
CONFIG_CMD_MEMORY=y
CONFIG_CMD_CRC32=y
CONFIG_LOOPW=y
CONFIG_CMD_MEMTEST=y
```
